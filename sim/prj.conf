## CMakeLists.txt
```
cmake_minimum_required(VERSION 3.20.0)

set(BOARD native_sim)

find_package(Zephyr REQUIRED HINTS $ENV{ZEPHYR_BASE})
project(sim_demo)

target_sources(app PRIVATE src/main.c)
```

## prj.conf
```kconfig
CONFIG_LOG=y
CONFIG_NATIVE_SIM_SLOWDOWN_TO_REAL_TIME=n
```

## src/main.c
```c
#include <zephyr/logging/log.h>
#include "posix_board_if.h"

LOG_MODULE_REGISTER(main);

int main(void)
{
    for (int i = 0; i < 10; i++) {
        LOG_INF("Hello World! %s", CONFIG_BOARD_TARGET);
        k_sleep(K_SECONDS(1));
    }

    posix_exit(0);
    return 0;
}
```
