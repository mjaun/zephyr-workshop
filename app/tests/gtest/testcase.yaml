## app/tests/gtest/testcase.yaml
```yaml
common:
  harness: gtest
tests:
  app.gtest:
    platform_allow: 
      - native_sim/native/64
```

## app/tests/ztest/testcase.yaml
```yaml
tests:
  app.ztest:
    platform_allow: 
      - demo
      - native_sim
    simulation_exclude:
      - renode
```
