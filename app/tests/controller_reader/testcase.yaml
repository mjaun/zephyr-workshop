## app/tests/controller_reader/testcase.yaml
```yaml
common:
  harness: gtest
tests:
  app.controller_reader:
    platform_allow: 
      - native_sim/native/64
```

## boards/demo/board.yml
```yaml
board:
  name: demo
  full_name: Workshop Demo Board
  socs:
    - name: stm32f411xe
```

## dts/bindings/buzzer.yaml
```yaml
description: |
  Demonstration of a simple driver to control a buzzer.

compatible: "buzzer"

properties:
  frequency:
    type: int
    required: true

  pwms:
    type: phandle-array
    required: true
    description: |
      PWM specifier for the buzzer.
```

## dts/bindings/fake-sensor.yaml
```yaml
description: |
  Fake sensor driver for testing.

compatible: "fake-sensor"

include: [sensor-device.yaml, base.yaml]
```

## tests/sensor_ctrl/testcase.yaml
```yaml
tests:
  workshop.sensor-ctrl:
    tags: workshop
    platform_allow: native_sim
```

## west-manifest/west.yml
```yaml
manifest:
  projects:
    - name: zephyr
      url: https://github.com/zephyrproject-rtos/zephyr
      revision: v4.4.0
      import:
        path-prefix: external
        name-allowlist:
          - cmsis_6
          - picolibc
          - segger
          - hal_stm32
          - hal_st

    - name: googletest
      url: https://github.com/google/googletest
      revision: v1.17.0
      path: external/googletest
```
