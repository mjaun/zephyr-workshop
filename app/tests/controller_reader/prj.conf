## CMakeLists.txt
```
cmake_minimum_required(VERSION 3.20.0)

find_package(Zephyr REQUIRED HINTS $ENV{ZEPHYR_BASE})
project(test_controller_reader)

execute_process(
    COMMAND west topdir 
    WORKING_DIRECTORY ${CMAKE_CURRENT_SOURCE_DIR} 
    OUTPUT_VARIABLE WEST_ROOT 
    OUTPUT_STRIP_TRAILING_WHITESPACE
    COMMAND_ERROR_IS_FATAL ANY
)

add_subdirectory(${WEST_ROOT}/external/googletest googletest)

target_link_libraries(app PRIVATE GTest::gmock GTest::gtest)
target_compile_definitions(app PRIVATE GTEST_HAS_PTHREAD=0)

target_include_directories(app PRIVATE ${WEST_ROOT}/app/src)

target_sources(app PRIVATE
    ${WEST_ROOT}/app/src/cpp_wrappers/ApplicationAssert.cpp
    ${WEST_ROOT}/app/src/SensorReader.cpp
    ${WEST_ROOT}/app/src/BuzzerController.cpp
    ${WEST_ROOT}/app/src/frequency.c
    src/BuzzerControllerTest.cpp
    src/main.cpp
)
```

## prj.conf
```kconfig
CONFIG_CPP=y
CONFIG_STD_CPP23=y
CONFIG_REQUIRES_FULL_LIBCPP=y
CONFIG_CPP_EXCEPTIONS=y
CONFIG_CPP_RTTI=y
```

## src/main.cpp
```c
#include <zephyr/kernel.h>
#include <gmock/gmock.h>
#include <vector>
#include "posix_board_if.h"
#include "nsi_cmdline.h"

extern "C" int main(void)
{
    int test_argc;
    char** test_argv;

    // returns all arguments after -testargs
    nsi_get_test_cmd_line_args(&test_argc, &test_argv);

    // prepend a dummy application name as argument 0
    std::vector<char*> argv;
    argv.push_back(const_cast<char*>("zephyr_test"));
    argv.insert(argv.end(), test_argv, test_argv + test_argc);
    int argc = static_cast<int>(argv.size());

    testing::InitGoogleMock(&argc, argv.data());

    int ret = RUN_ALL_TESTS();

    posix_exit(ret);
    return 0;
}
```

## src/BuzzerControllerTest.cpp
```c
#include <gtest/gtest.h>
#include <gmock/gmock.h>
#include "cpp_wrappers/Buzzer.hpp"
#include "cpp_wrappers/Thread.hpp"
#include "cpp_wrappers/MessageQueue.hpp"
#include "BuzzerController.hpp"

K_THREAD_STACK_DEFINE(thread_stack, 1024);

class BuzzerMock : public IBuzzer
{
public:
    MOCK_METHOD(void, enable, (uint32_t freq));
    MOCK_METHOD(void, disable, ());
};

class BuzzerControllerTest : public testing::Test
{
protected:
    BuzzerMock _buzzer_mock;

    Thread _thread{thread_stack, K_THREAD_STACK_SIZEOF(thread_stack), 5};
    MessageQueue<float> _message_queue{3};
    BuzzerController _buzzer_controller{_thread, _message_queue, _buzzer_mock};
};

TEST_F(BuzzerControllerTest, AboveThresholdDisablesBuzzer)
{
    _message_queue.put(8.1f);

    EXPECT_CALL(_buzzer_mock, disable());

    _buzzer_controller.start();
    k_msleep(1);
}

TEST_F(BuzzerControllerTest, AtMinAccelEnablesWithMinFreq)
{
    _message_queue.put(8.0f);

    EXPECT_CALL(_buzzer_mock, enable(500));

    _buzzer_controller.start();
    k_msleep(1);
}

TEST_F(BuzzerControllerTest, AtMaxAccelEnablesWithMaxFreq)
{
    _message_queue.put(-9.0f);

    EXPECT_CALL(_buzzer_mock, enable(3000));

    _buzzer_controller.start();
    k_msleep(1);
}

TEST_F(BuzzerControllerTest, AtMidPointEnablesWithFreq)
{
    _message_queue.put(-0.5f);

    /* accel = -0.5: 500 + (-0.5 - 8) * 2500 / -17 = 1750 */
    EXPECT_CALL(_buzzer_mock, enable(1750));

    _buzzer_controller.start();
    k_msleep(1);
}
```
